## Documentation/devicetree/bindings/display/panel/novatek,nt36525b.yaml
```yaml
# SPDX-License-Identifier: GPL-2.0-only OR BSD-2-Clause
%YAML 1.2
---
$id: http://devicetree.org/schemas/display/panel/novatek,nt36525b.yaml#
$schema: http://devicetree.org/meta-schemas/core.yaml#

title: Novatek NT36525B LCD DSI Panel

maintainers:
  - Val Packett <val@packett.cool>

allOf:
  - $ref: panel-common.yaml#

properties:
  compatible:
    items:
      - const: tianma,nt36525b-cebu
      - const: novatek,nt36525b

  reg:
    maxItems: 1
    description: DSI virtual channel

  avdd-supply: true
  avee-supply: true
  vddi-supply: true
  port: true
  reset-gpios: true
  backlight: true

required:
  - compatible
  - reg
  - vddi-supply
  - avdd-supply
  - avee-supply
  - port

unevaluatedProperties: false

examples:
  - |
    #include <dt-bindings/gpio/gpio.h>
    dsi {
        #address-cells = <1>;
        #size-cells = <0>;
        panel@0 {
            compatible = "tianma,nt36525b-cebu", "novatek,nt36525b";
            reg = <0>;

            avdd-supply = <&pmi632_lcdb_ldo>;
            avee-supply = <&pmi632_lcdb_ncp>;
            vddi-supply = <&pm6125_l9a>;

            backlight = <&i2c_backlight>;

            port {
                panel_in: endpoint {
                    remote-endpoint = <&mdss_dsi0_out>;
                };
            };
        };
    };
...
```

## Documentation/devicetree/bindings/leds/backlight/awinic,aw99703.yaml
```yaml
# SPDX-License-Identifier: (GPL-2.0-only OR BSD-2-Clause)
%YAML 1.2
---
$id: http://devicetree.org/schemas/leds/backlight/awinic,aw99703.yaml#
$schema: http://devicetree.org/meta-schemas/core.yaml#

title: Awinic AW99703 WLED Backlight Driver

maintainers:
  - Luka Panio <lukapanio@gmail.com>

description:
  The AW99703 is a 3-string WLED driver with an integrated boost converter
  and 11-bit I2C (optionally PWM) brightness control.

allOf:
  - $ref: common.yaml#

properties:
  compatible:
    const: awinic,aw99703

  reg:
    maxItems: 1

  enable-gpios:
    description: GPIO connected to the HWEN pin.
    maxItems: 1

  awinic,led-strings:
    description: Number of enabled LED strings, starting with CH1.
    $ref: /schemas/types.yaml#/definitions/uint32
    minimum: 1
    maximum: 3
    default: 3

  awinic,iled-max-microamp:
    description:
      Full-scale current of each LED string, reached at the maximum
      brightness code (and 100% PWM duty cycle if PWM dimming is used).
    minimum: 4800
    maximum: 29600
    multipleOf: 800
    default: 20000

  awinic,ramp-on-time-us:
    description: Current sink ramp-up time when leaving standby.
    enum: [512, 1000, 2000, 4000, 8000, 16000, 32000, 64000, 128000,
           256000, 512000, 1024000, 2048000, 4096000, 8192000, 16384000]
    default: 8000

  awinic,ramp-off-time-us:
    description: Current sink ramp-down time when entering standby.
    enum: [512, 1000, 2000, 4000, 8000, 16000, 32000, 64000, 128000,
           256000, 512000, 1024000, 2048000, 4096000, 8192000, 16384000]
    default: 8000

  awinic,pwm-trans-time-ms:
    description:
      Transition time between brightness levels set by the PWM input,
      for a change over the full duty cycle range.
    enum: [2, 4, 8, 16, 32, 64, 128, 256]
    default: 2

  awinic,i2c-trans-time-ms:
    description:
      Fixed transition time between brightness levels set over I2C,
      independent of the size of the change. When absent the brightness
      ramps with a fixed slope of 1 us per brightness code instead.
    enum: [128, 192, 256, 320, 384, 448, 512, 576, 640, 768, 1024, 1280,
           1536, 2560, 4096]

  awinic,ovp-microvolt:
    description: Boost over-voltage protection threshold.
    enum: [17500000, 24000000, 31000000, 38000000, 41500000]
    default: 38000000

  awinic,ocp-microamp:
    description: Boost over-current protection threshold.
    enum: [900000, 1800000, 2700000, 3400000]
    default: 2700000

  awinic,sw-freq-hz:
    description: Boost switching frequency.
    enum: [500000, 1000000]
    default: 1000000

  awinic,inductor-nanohenry:
    description: Boost inductor value.
    $ref: /schemas/types.yaml#/definitions/uint32
    enum: [4700, 10000]
    default: 4700

  awinic,pwm-input:
    description: Combine the PWM input pin with the I2C brightness.
    type: boolean

  awinic,exponential-map:
    description: Use the exponential brightness curve instead of linear.
    type: boolean

  default-brightness:
    maximum: 2047

  max-brightness:
    maximum: 2047

required:
  - compatible
  - reg

unevaluatedProperties: false

examples:
  - |
    #include <dt-bindings/gpio/gpio.h>

    i2c {
        #address-cells = <1>;
        #size-cells = <0>;

        backlight@36 {
            compatible = "awinic,aw99703";
            reg = <0x36>;
            enable-gpios = <&gpio 7 GPIO_ACTIVE_HIGH>;
            awinic,led-strings = <2>;
            awinic,iled-max-microamp = <20000>;
            awinic,ocp-microamp = <3400000>;
            awinic,inductor-nanohenry = <10000>;
        };
    };
```

## Documentation/devicetree/bindings/usb/fcs,fsa4480.yaml
```yaml
# SPDX-License-Identifier: GPL-2.0-only OR BSD-2-Clause
%YAML 1.2
---
$id: http://devicetree.org/schemas/usb/fcs,fsa4480.yaml#
$schema: http://devicetree.org/meta-schemas/core.yaml#

title: ON Semiconductor Analog Audio Switch

maintainers:
  - Bjorn Andersson <bjorn.andersson@linaro.org>

$defs:
  controller-port:
    $ref: /schemas/graph.yaml#/$defs/port-base
    description:
      A port node to link the FSA4480 to a Type-C controller for the purpose of
      handling altmode muxing and orientation switching.
    unevaluatedProperties: false

    properties:
      endpoint:
        $ref: /schemas/graph.yaml#/$defs/endpoint-base
        unevaluatedProperties: false

        properties:
          data-lanes:
            $ref: /schemas/types.yaml#/definitions/uint32-array
            description:
              Specifies how the AUX+/- lines are connected to SBU1/2.
            oneOf:
              - items:
                  - const: 0
                  - const: 1
                description: |
                  Default AUX/SBU layout (FSA4480)
                  - AUX+ connected to SBU2
                  - AUX- connected to SBU1
                  Default AUX/SBU layout (OCP96011)
                  - AUX+ connected to SBU1
                  - AUX- connected to SBU2
              - items:
                  - const: 1
                  - const: 0
                description: |
                  Swapped AUX/SBU layout (FSA4480)
                  - AUX+ connected to SBU1
                  - AUX- connected to SBU2
                  Swapped AUX/SBU layout (OCP96011)
                  - AUX+ connected to SBU2
                  - AUX- connected to SBU1

properties:
  compatible:
    oneOf:
      - const: fcs,fsa4480
      - items:
          - enum:
              - ocs,ocp96011
          - const: fcs,fsa4480

  reg:
    maxItems: 1

  interrupts:
    maxItems: 1

  vcc-supply:
    description: power supply (2.7V-5.5V)

  mode-switch: true
  orientation-switch: true

  port:
    $ref: "#/$defs/controller-port"

  ports:
    $ref: /schemas/graph.yaml#/properties/ports

    properties:
      port@0:
        $ref: "#/$defs/controller-port"
      port@1:
        $ref: /schemas/graph.yaml#/properties/port
        description:
          A port node to link the FSA4480 to an audio codec for the purpose of
          handling Audio Accessory Mode muxing and orientation switching.

    required:
      - port@0

required:
  - compatible
  - reg

allOf:
  - $ref: usb-switch.yaml#

oneOf:
  - required:
      - port
  - required:
      - ports

additionalProperties: false

examples:
  - |
    #include <dt-bindings/interrupt-controller/irq.h>
    i2c13 {
        #address-cells = <1>;
        #size-cells = <0>;

        typec-mux@42 {
            compatible = "fcs,fsa4480";
            reg = <0x42>;

            interrupts-extended = <&tlmm 2 IRQ_TYPE_LEVEL_LOW>;

            vcc-supply = <&vreg_bob>;

            mode-switch;
            orientation-switch;

            ports {
                #address-cells = <1>;
                #size-cells = <0>;

                port@0 {
                    reg = <0>;

                    fsa4480_sbu_mux: endpoint {
                        remote-endpoint = <&typec_controller>;
                    };
                };

                port@1 {
                    reg = <1>;

                    fsa4480_audio: endpoint {
                        remote-endpoint = <&audio_codec>;
                    };
                };
            };
        };
    };
...
```
