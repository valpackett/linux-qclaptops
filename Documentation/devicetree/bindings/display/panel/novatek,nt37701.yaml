## Documentation/devicetree/bindings/display/panel/novatek,nt37701.yaml
```yaml
# SPDX-License-Identifier: GPL-2.0-only OR BSD-2-Clause
%YAML 1.2
---
$id: http://devicetree.org/schemas/display/panel/novatek,nt37701.yaml#
$schema: http://devicetree.org/meta-schemas/core.yaml#

title: Novatek NT37701-based DSI display panels

maintainers:
  - Val Packett <val@packett.cool>

description:
  The Novatek NT37701 is a generic DSI Panel IC used to control AMOLED panels.

allOf:
  - $ref: panel-common.yaml#

properties:
  compatible:
    items:
      - enum:
          - csot,nt37701-dubai
          - tianma,nt37701-dubai
      - const: novatek,nt37701

  reg:
    maxItems: 1

  vddio-supply:
    description: I/O voltage rail

  dvdd-supply:
    description: Digital voltage rail

  vdd-supply:
    description: Analog voltage rail

required:
  - compatible
  - reg
  - reset-gpios
  - vddio-supply
  - dvdd-supply
  - vdd-supply
  - port

unevaluatedProperties: false

examples:
  - |
    #include <dt-bindings/gpio/gpio.h>

    dsi {
        #address-cells = <1>;
        #size-cells = <0>;

        panel@0 {
            compatible = "tianma,nt37701-dubai", "novatek,nt37701";
            reg = <0>;

            reset-gpios = <&tlmm 44 GPIO_ACTIVE_LOW>;

            dvdd-supply = <&disp_dvdd_1p25>;
            vdd-supply = <&disp_vci_3p0>;
            vddio-supply = <&disp_iovcc_1p8>;

            port {
                panel_in_0: endpoint {
                    remote-endpoint = <&dsi0_out>;
                };
            };
        };
    };

...
```

## Documentation/devicetree/bindings/media/i2c/ovti,ov13858.yaml
```yaml
# SPDX-License-Identifier: (GPL-2.0-only OR BSD-2-Clause)
%YAML 1.2
---
$id: http://devicetree.org/schemas/media/i2c/ovti,ov13858.yaml#
$schema: http://devicetree.org/meta-schemas/core.yaml#

title: OmniVision OV13858 13 Megapixel CMOS Image Sensor

maintainers:
  - Tawheed Makhdoomi <_@tawheed.cc>

description:
  The OmniVision OV13858 is a 1/3-inch 13 megapixel CMOS image sensor with a
  4-lane MIPI CSI-2 output, controlled over I2C (SCCB). The driver needs a
  19.2 MHz external clock.

allOf:
  - $ref: /schemas/media/video-interface-devices.yaml#

properties:
  compatible:
    const: ovti,ov13858

  reg:
    maxItems: 1

  clocks:
    description: External clock (XVCLK), 19.2 MHz.
    maxItems: 1

  dovdd-supply:
    description: Digital I/O voltage supply, 1.8 V.

  avdd-supply:
    description: Analog voltage supply, 2.8 V.

  dvdd-supply:
    description: Digital core voltage supply, 1.2 V.

  reset-gpios:
    description:
      GPIO connected to the XSHUTDOWN pin, which is physically active low.
    maxItems: 1

  port:
    description: MIPI CSI-2 transmitter port
    $ref: /schemas/graph.yaml#/$defs/port-base
    additionalProperties: false

    properties:
      endpoint:
        $ref: /schemas/media/video-interfaces.yaml#
        unevaluatedProperties: false

        properties:
          data-lanes:
            items:
              - const: 1
              - const: 2
              - const: 3
              - const: 4

          link-frequencies: true

        required:
          - data-lanes

required:
  - compatible
  - reg
  - clocks
  - port

unevaluatedProperties: false

examples:
  - |
    #include <dt-bindings/gpio/gpio.h>

    i2c {
        #address-cells = <1>;
        #size-cells = <0>;

        camera@10 {
            compatible = "ovti,ov13858";
            reg = <0x10>;

            clocks = <&camcc 99>;
            assigned-clocks = <&camcc 99>;
            assigned-clock-rates = <19200000>;

            dovdd-supply = <&vreg_l14a_1p8>;
            avdd-supply = <&vreg_l17a_2p85>;
            dvdd-supply = <&vreg_l1a_1p2>;

            reset-gpios = <&tlmm 22 GPIO_ACTIVE_LOW>;

            port {
                endpoint {
                    remote-endpoint = <&csiphy0_ep>;
                    data-lanes = <1 2 3 4>;
                    link-frequencies = /bits/ 64 <540000000 270000000>;
                };
            };
        };
    };
...
```
